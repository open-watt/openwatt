## platforms/esp32/sdkconfig.defaults
```kconfig
# Minimal ESP-IDF config for OpenWatt on ESP32
# Strip everything we don't need -- OpenWatt manages its own I/O, networking, and logging.

# Enable C++ exception unwinding (required for D exception mechanism)
CONFIG_COMPILER_CXX_EXCEPTIONS=y

# Console over default UART
CONFIG_ESP_CONSOLE_UART_DEFAULT=y

# No ESP-IDF logging -- OpenWatt has its own log system
CONFIG_LOG_DEFAULT_LEVEL_NONE=y

# No VFS layer (virtual filesystem for stdio redirection)
CONFIG_VFS_SUPPORT_IO=n
CONFIG_VFS_SUPPORT_DIR=n
CONFIG_VFS_SUPPORT_SELECT=n

# FreeRTOS tuning
CONFIG_FREERTOS_HZ=1000
CONFIG_FREERTOS_TASK_STACK_SIZE_IN_BYTES=y
CONFIG_FREERTOS_IDLE_TASK_STACKSIZE=2048
CONFIG_ESP_MAIN_TASK_STACK_SIZE=16384

# No watchdog on idle tasks (we run a tight main loop)
CONFIG_ESP_TASK_WDT_INIT=n

# Single-core mode (saves IRAM, simplifies FreeRTOS)
CONFIG_FREERTOS_UNICORE=y

# Heap: use all available SRAM regions
CONFIG_HEAP_POISONING_DISABLED=y

# PSRAM (optional SPI PSRAM -- enable if module has it)
#CONFIG_SPIRAM=y
#CONFIG_SPIRAM_SPEED_80M=y

# WiFi: allow buffers in PSRAM if available
CONFIG_SPIRAM_TRY_ALLOCATE_WIFI_LWIP=y

# No Bluetooth
CONFIG_BT_ENABLED=n

# Flash: 4MB SPI flash (most common ESP32 module)
CONFIG_ESPTOOLPY_FLASHSIZE_4MB=y

# Custom partition table
CONFIG_PARTITION_TABLE_CUSTOM=y
CONFIG_PARTITION_TABLE_CUSTOM_FILENAME="partitions.csv"
```

## platforms/esp32c2/sdkconfig.defaults
```kconfig
# Minimal ESP-IDF config for OpenWatt on ESP32-C2

CONFIG_COMPILER_CXX_EXCEPTIONS=y
CONFIG_ESP_CONSOLE_UART_DEFAULT=y
CONFIG_LOG_DEFAULT_LEVEL_NONE=y
CONFIG_VFS_SUPPORT_IO=n
CONFIG_VFS_SUPPORT_DIR=n
CONFIG_VFS_SUPPORT_SELECT=n
CONFIG_FREERTOS_HZ=1000
CONFIG_FREERTOS_TASK_STACK_SIZE_IN_BYTES=y
CONFIG_FREERTOS_IDLE_TASK_STACKSIZE=2048
CONFIG_ESP_MAIN_TASK_STACK_SIZE=16384
CONFIG_ESP_TASK_WDT_INIT=n
CONFIG_FREERTOS_UNICORE=y
CONFIG_HEAP_POISONING_DISABLED=y
CONFIG_SPIRAM_TRY_ALLOCATE_WIFI_LWIP=y
CONFIG_BT_ENABLED=n
CONFIG_ESPTOOLPY_FLASHSIZE_4MB=y
CONFIG_PARTITION_TABLE_CUSTOM=y
CONFIG_PARTITION_TABLE_CUSTOM_FILENAME="partitions.csv"
```

## platforms/esp32p4/sdkconfig.defaults
```kconfig
# Minimal ESP-IDF config for OpenWatt on ESP32-P4
# Strip everything we don't need -- OpenWatt manages its own I/O, networking, and logging.

# Enable C++ exception unwinding (required for D exception mechanism)
CONFIG_COMPILER_CXX_EXCEPTIONS=y

# Console over UART (P4 uses UART0 by default)
CONFIG_ESP_CONSOLE_UART_DEFAULT=y

# No ESP-IDF logging -- OpenWatt has its own log system
CONFIG_LOG_DEFAULT_LEVEL_NONE=y

# No VFS layer (virtual filesystem for stdio redirection)
CONFIG_VFS_SUPPORT_IO=n
CONFIG_VFS_SUPPORT_DIR=n
CONFIG_VFS_SUPPORT_SELECT=n

# FreeRTOS tuning
CONFIG_FREERTOS_HZ=1000
CONFIG_FREERTOS_TASK_STACK_SIZE_IN_BYTES=y
CONFIG_FREERTOS_IDLE_TASK_STACKSIZE=2048
CONFIG_ESP_MAIN_TASK_STACK_SIZE=16384

# No watchdog on idle tasks (we run a tight main loop)
CONFIG_ESP_TASK_WDT_INIT=n

# Single-core mode (HP core only)
CONFIG_FREERTOS_UNICORE=y

# Heap: use all available SRAM regions
CONFIG_HEAP_POISONING_DISABLED=y

# PSRAM -- P4 supports HyperRAM up to 32MB
CONFIG_SPIRAM=y
CONFIG_SPIRAM_SPEED_200M=y

# WiFi: P4 has no built-in radio -- WiFi requires external module
CONFIG_ESP_WIFI_ENABLED=n

# No Bluetooth
CONFIG_BT_ENABLED=n

# Flash: 16MB SPI flash
CONFIG_ESPTOOLPY_FLASHSIZE_16MB=y

# Custom partition table
CONFIG_PARTITION_TABLE_CUSTOM=y
CONFIG_PARTITION_TABLE_CUSTOM_FILENAME="partitions.csv"
```

## platforms/esp32s3/sdkconfig.defaults
```kconfig
# Minimal ESP-IDF config for OpenWatt on ESP32-S3
# Strip everything we don't need -- OpenWatt manages its own I/O, networking, and logging.

# Enable C++ exception unwinding (required for D exception mechanism)
CONFIG_COMPILER_CXX_EXCEPTIONS=y

# Console over native USB Serial/JTAG (the USB port, not UART pins)
CONFIG_ESP_CONSOLE_USB_SERIAL_JTAG=y

# No ESP-IDF logging -- OpenWatt has its own log system
CONFIG_LOG_DEFAULT_LEVEL_NONE=y

# No VFS layer (virtual filesystem for stdio redirection)
CONFIG_VFS_SUPPORT_IO=n
CONFIG_VFS_SUPPORT_DIR=n
CONFIG_VFS_SUPPORT_SELECT=n

# FreeRTOS tuning
CONFIG_FREERTOS_HZ=1000
CONFIG_FREERTOS_TASK_STACK_SIZE_IN_BYTES=y
CONFIG_FREERTOS_IDLE_TASK_STACKSIZE=2048
CONFIG_ESP_MAIN_TASK_STACK_SIZE=16384

# No watchdog on idle tasks (we run a tight main loop)
CONFIG_ESP_TASK_WDT_INIT=n

# Single-core mode (saves ~4KB IRAM, simplifies FreeRTOS)
CONFIG_FREERTOS_UNICORE=y

# Heap: use all available SRAM regions
CONFIG_HEAP_POISONING_DISABLED=y

# PSRAM (external SPI RAM) -- 8MB octal on this module
CONFIG_SPIRAM=y
CONFIG_SPIRAM_MODE_OCT=y
CONFIG_SPIRAM_SPEED_80M=y

# WiFi: allow buffers in PSRAM to save internal SRAM
CONFIG_SPIRAM_TRY_ALLOCATE_WIFI_LWIP=y

# Bluetooth: NimBLE host + ESP32-S3 BLE controller
CONFIG_BT_ENABLED=y
CONFIG_BT_NIMBLE_ENABLED=y

# Flash: 16MB SPI flash
CONFIG_ESPTOOLPY_FLASHSIZE_16MB=y

# Custom partition table: two 3MB OTA slots + ~10MB storage
CONFIG_PARTITION_TABLE_CUSTOM=y
CONFIG_PARTITION_TABLE_CUSTOM_FILENAME="partitions.csv"
```
